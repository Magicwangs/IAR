/******************** (C) COPYRIGHT 2011 蓝宙电子工作室 ********************
 * 文件名       ：main.c
 * 描述         ：工程模版实验
 *
 * 实验平台     ：landzo电子开发版
 * 库版本       ：
 * 嵌入系统     ：
 *
 * 作者         ：landzo 蓝电子
 * 淘宝店       ：http://landzo.taobao.com/

**********************************************************************************/

#include "include.h"


/*************************
设置系统的全局变量
*************************/


extern  u8  LPT_INT_count ;
extern  u8  DMA_Over_Flg ;            //采集完成标志位
extern  u8  LinADCout ;

extern double pwm_gain_temp;
int count_sin=0;
int group_id=3;
int Power_Flag=1;

int pwm_duty=10;

int pwm_gain=12;

double U0_Correct=(36/33+1.65)/3.3*4095;

int pwm_freq=40000;
double pwm_gain_temp=10;


double Kp_u=38.0;
double Ki_u=1.0;
double f0_set=99.0;


double U0_present_value=51.0;
double I0_present_value=2.8;
double U2_present_value=67.9;

int U0_sample=0;
int I0_sample=0;

double U0_present_max=0;
double I0_present_max=0;

int U0_sample_max=0;
int I0_sample_max=0;

int start_flag=0;

double Voltage_Error[2]={0,0};



int modeflag=0;
int ftm_flag=0;
int PID_flag=0;
int Freq_change_flag=0;

char buf[20];


int data_sin_1[555]=
{
500,504,508,513,517,521,525,530,534,538,542,547,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496

};
int data_sin_2[333]=
{
500,507,514,521,528,535,542,549,556,563,570,577,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493

};
int data_sin_3[199]=
{
500,512,524,535,547,559,571,582,594,605,616,628,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488

};

int test_sin[5]=
{
  100,300,500,100,900
};

extern u16  TimeCount ;
int PID=1;

void Pot_Show(int x,int y,double final_adc);
void OLED_Light();
void Refresh_Present();
void Refresh_Key();
void PID_control();
void Curent_PID();
void Voltage_PID();
void PWM_Control();



void main()
{
  DisableInterrupts;                             //禁止总中断

  /*********************************************************
  初始化程序
  *********************************************************/

   uart_init (UART0 , 115200);                      //初始化UART0，输出脚PTA15，输入脚PTA14，串口频率 9600
   
   Init_Key_Port();
   
  
   
   OLED_Init();
   gpio_init (PORTB ,5, GPO,LOW); //B5 低电平开启
   
   adc_init(ADC0, AD9);  //B1  I0
   adc_init(ADC0,AD12);  //B2  U0
   
   pit_init_us(PIT0, 300);                                    //初始化PIT0，定时时间为： 300us

   FTM_Input_init(FTM1,CH0,Rising);  //A8输入捕捉初始化
   
   FTM0_Init(40000 ,500);  //C3、C4初始化
   
   EnableInterrupts; //开总中断

   OLED_Light();
   
   
   /******************************************
    执行程序
    ******************************************/
    while(1)
    {
        Key_Event(); 
        if(PID_flag==1)
        {
            I0_present_max=I0_sample_max*3.3/4095;
            I0_present_max=(I0_present_max*3-2.5)/0.185;
            U0_present_max=U0_sample_max*3.3/4095;
            U0_present_max=(U0_present_max-1.65)*50/1.41;
            if(PID==1)
            {
              Voltage_PID();
            }
            
            
            U0_sample_max=0;
            I0_sample_max=0; 
            PID_flag=0;
        }
    }

}


void OLED_Light()
{
  OLED_Fill(0x00);  //液晶屏全黑
  Dly_ms(50);
  
  OLED_P6x8Str(0,0,"U0:");
  Pot_Show(20,0,U0_present_value);
  OLED_P6x8Str(65,0,"I0:");
  Pot_Show(85,0,I0_present_value);
  
  OLED_P6x8Str(0,1,"U2:");
  Pot_Show(20,1,U2_present_value);  
  
  OLED_P6x8Str(0,2,"f0:");
  Pot_Show(20,2,f0_set);  
  OLED_P6x8Str(65,2,"Pow:");
  Pot_Show(90,2,Power_Flag);
  
  
  OLED_P6x8Str(0,3,"Kp:");
  Pot_Show(20,3,Kp_u);
  
  OLED_P6x8Str(0,4,"Ki:");
  Pot_Show(20,4,Ki_u);
 
  OLED_P6x8Str(0,6,"gain:");
   Pot_Show(28,6,pwm_gain);
}


void Refresh_Key()
{

  Pot_Show(20,2,f0_set);  
  
  Pot_Show(20,3,Kp_u);
  
  Pot_Show(20,4,Ki_u);
  
  if(f0_set>=34 && f0_set<=60)
  {
    group_id=2;
    pwm_freq=(int)(2*333*f0_set);
  }
  else if(f0_set>=20 && f0_set<36)
  {
    group_id=1;
    pwm_freq=(int)(2*555*f0_set);
  }
  else if(f0_set>58 && f0_set<=100)
  {
    group_id=3;
    pwm_freq=(int)(2*199*f0_set);
  }
  
  FTM0_Freq_Change(pwm_freq);
  
}

void Refresh_Present()
{

   Pot_Show(90,2,Power_Flag);
  Pot_Show(20,0,U0_present_max);

  Pot_Show(85,0,I0_present_max);

  //Pot_Show(20,1,U2_present_value); 
  
  Pot_Show(28,6,pwm_gain_temp);
  
}



void Pot_Show(int x,int y,double final_adc)
{
  u8  adc_num[]="00.00" ;
  
  int int_adc_1=0;
  int int_adc_2=0;
  int pot_adc_1=0;
  int pot_adc_2=0;
  int adc_temp=0;
  
  adc_temp=final_adc*100;
  int_adc_1=adc_temp/1000;
  int_adc_2=adc_temp/100-int_adc_1*10;
  pot_adc_1=adc_temp/10-int_adc_1*100-int_adc_2*10;
  pot_adc_2=adc_temp-int_adc_1*1000-int_adc_2*100-pot_adc_1*10;
        
  sprintf(adc_num, "%d%d.%d%d",int_adc_1,int_adc_2,pot_adc_1,pot_adc_2); 
  
  OLED_P6x8Str(x,y,adc_num);  
}


void PID_control()
{
  
}


void Voltage_PID()
{
  Voltage_Error[1]=Voltage_Error[0];
  Voltage_Error[0]=55-U0_present_max;
  
  pwm_gain_temp=(Voltage_Error[0]-Voltage_Error[1])*Kp_u/100+Voltage_Error[0]*Ki_u+pwm_gain_temp;
  
  if(pwm_gain_temp>=12) pwm_gain_temp=12;
  if(pwm_gain_temp<=8) pwm_gain_temp=8;
  
  //pwm_gain=pwm_gain_temp;
}


void PWM_Control()
{  
  if(start_flag==1)
  {
    if(group_id==1)
    {
      if(count_sin>554)
      {
        count_sin=0;
        PID_flag=1;
      }
      pwm_duty=pwm_gain*data_sin_1[count_sin]/10;
      if(pwm_duty>=1000)
      {
        pwm_duty=999;
      }
      FTM0_Duty_Change(pwm_duty);
      count_sin++;
    }
    
    if(group_id==2)
    {
      if(count_sin>332)
      {
        count_sin=0;
        PID_flag=1;
      }
      pwm_duty=pwm_gain*data_sin_2[count_sin]/10;
      if(pwm_duty>=1000)
      {
        pwm_duty=999;
      }
      FTM0_Duty_Change(pwm_duty);
      count_sin++;
    }
  
    if(group_id==3)
    {
      if(count_sin>198)
      {
        count_sin=0;
        PID_flag=1; 
      }
      pwm_duty=pwm_gain*data_sin_3[count_sin]/10;
      if(pwm_duty>=1000)
      {
        pwm_duty=999;
      }
      FTM0_Duty_Change(pwm_duty);
      count_sin++;
    }
    
    
  }
      
}

